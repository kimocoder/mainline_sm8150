// SPDX-License-Identifier: BSD-3-Clause
/*
 * Copyright (c) 2022, Aleksnadr Volkov <adomerlee@gmail.com>
 */

/dts-v1/;

#include "sm8150-v2.dtsi"

/ {
	model = "Qualcomm Technologies, Inc. SM8150 v2 SoC";
	compatible = "qcom,sm8150";
	qcom,pmic-name = "PM8150";
	qcom,board-id = <0 0>;
};
